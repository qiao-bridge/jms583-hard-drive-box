/*
 * stc8g_ntc_table.c
 * ==================
 * NTC 温度<->RAW 查表（一张表，全 short，无 float）
 *
 * 存储：一维 int16_t 数组 raw_table[146]
 *        下标 i = 温度 + TEMP_OFFSET (= 20)
 *        实际温度 = i - 20   =>  i=0 是 -20C, i=20 是 0C, i=145 是 125C
 *        值 = 该温度对应的 ADC 采集值 RAW
 *
 * RAW 来源：用户 RT 表(R值) + 比值公式
 *         RAW = 1023 * 10k / (R_ntc + 10k)
 *         （上 NTC + 下 10k，VREF=VCC，比值约掉）
 *         已做单调递增修正（相邻最小间隔 1，保证二分正确）
 */

#include "stc8g_ntc_table.h"

/* ============ 查表数据 ============ */
const short raw_table[NTC_TABLE_SIZE] = {
      10,  //  -20C
      10,  //  -19C
      11,  //  -18C
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     707,  //  124C
     708  //  125C
};

/* ============ 查表函数：RAW -> 温度(℃) ============ */

/*
 * 二分查找 + 整数线性插值
 * 表是单调递增的（温度越高 RAW 越大），找 raw 落在哪两个相邻点之间
 */
int ntc_raw_to_temp(int raw)
{
    int lo, hi, mid;
    int r1, r2;
    int t1, t2;
    int temp;

    /* 边界钳制 */
    if (raw <= raw_table[0]) {
        return NTC_T_MIN;          /* -20C */
    }
    if (raw >= raw_table[NTC_TABLE_SIZE - 1]) {
        return NTC_T_MAX;          /* 125C */
    }

    /* 二分：找第一个 raw_table[mid] > raw 的位置 */
    lo = 0;
    hi = NTC_TABLE_SIZE - 1;
    while (hi - lo > 1) {
        mid = (lo + hi) >> 1;
        if (raw_table[mid] <= raw) {
            lo = mid;
        } else {
            hi = mid;
        }
    }
    /* 此时 raw 在 raw_table[lo] 与 raw_table[hi] 之间 */

    r1 = raw_table[lo];
    r2 = raw_table[hi];
    t1 = lo - TEMP_OFFSET;     /* 实际温度(℃) */
    t2 = hi - TEMP_OFFSET;

    /* 整数线性插值：temp = t1 + (raw - r1) * (t2 - t1) / (r2 - r1) */
    if (r2 - r1 <= 1) {
        /* 两点 RAW 几乎相同（高温区压缩），取中点 */
        temp = (t1 + t2) >> 1;
    } else {
        temp = t1 + (int)(((long)(raw - r1) * (long)(t2 - t1)) / (long)(r2 - r1));
    }

    return temp;
}
